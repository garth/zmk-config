## config/boards/shields/beamer/Kconfig.defconfig
```kconfig
# Copyright (c) 2020 The ZMK Contributors
# SPDX-License-Identifier: MIT

if SHIELD_BEAMER_LEFT

config ZMK_KEYBOARD_NAME
  default "Beamer"

config ZMK_SPLIT_BLE_ROLE_CENTRAL
  default y

endif

if SHIELD_BEAMER_LEFT || SHIELD_BEAMER_RIGHT

config ZMK_SPLIT
  default y

endif
```

## config/boards/shields/beamer/Kconfig.shield
```kconfig
# Copyright (c) 2020 The ZMK Contributors
# SPDX-License-Identifier: MIT

config SHIELD_BEAMER_LEFT
  def_bool $(shields_list_contains,beamer_left)

config SHIELD_BEAMER_RIGHT
  def_bool $(shields_list_contains,beamer_right)
```
