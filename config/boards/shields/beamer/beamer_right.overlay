/*
 * Copyright (c) 2020 The ZMK Contributors
 *
 * SPDX-License-Identifier: MIT
 */

#include "beamer.dtsi"

&kscan1 {
	col-gpios
		= <&pro_micro 21 GPIO_ACTIVE_HIGH>
		, <&pro_micro 20 GPIO_ACTIVE_HIGH>
		, <&pro_micro 19 GPIO_ACTIVE_HIGH>
		, <&pro_micro 18 GPIO_ACTIVE_HIGH>
		, <&pro_micro 15 GPIO_ACTIVE_HIGH>
		;
};

&kscan2 {
	input-gpios
		= <&pro_micro 10 (GPIO_ACTIVE_LOW | GPIO_PULL_UP)>
		, <&pro_micro  9 (GPIO_ACTIVE_LOW | GPIO_PULL_UP)>
		, <&pro_micro 16 (GPIO_ACTIVE_LOW | GPIO_PULL_UP)>
		;
};
